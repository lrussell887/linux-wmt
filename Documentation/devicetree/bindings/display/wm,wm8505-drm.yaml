## Documentation/devicetree/bindings/display/wm,wm8505-drm.yaml
```yaml
# SPDX-License-Identifier: (GPL-2.0-only OR BSD-2-Clause)
%YAML 1.2
---
$id: http://devicetree.org/schemas/display/wm,wm8505-drm.yaml#
$schema: http://devicetree.org/meta-schemas/core.yaml#

title: WonderMedia WM8505 DRM/KMS Display Controller

maintainers:
  - Logan Russell <me@lrussell.net>

properties:
  compatible:
    const: wm,wm8505-drm

  reg:
    items:
      - description: Graphics Output (GOVRH) registers
      - description: Video Post Processor (VPP) registers

  reg-names:
    items:
      - const: govrh
      - const: vpp

  interrupts:
    maxItems: 1
    description: VPP vertical blanking interrupt

  clocks:
    maxItems: 4

  clock-names:
    items:
      - const: dvo
      - const: govrh
      - const: vpp
      - const: ge

  wm,ge:
    $ref: /schemas/types.yaml#/definitions/phandle
    description: Phandle to the 2D Graphics Engine (GE) node

  port:
    $ref: /schemas/graph.yaml#/properties/port
    description: Output port endpoint for the display panel

required:
  - compatible
  - reg
  - reg-names
  - interrupts
  - clocks
  - clock-names
  - wm,ge

additionalProperties: false

examples:
  - |
    #include <dt-bindings/clock/wm8505-clock.h>

    display@d8050800 {
        compatible = "wm,wm8505-drm";
        reg = <0xd8050800 0x200>, <0xd8050f00 0x100>;
        reg-names = "govrh", "vpp";
        interrupt-parent = <&intc1>;
        interrupts = <16>;
        clocks = <&pmc WM8505_CLK_DVO>,
                 <&pmc WM8505_CLK_GOVRHD>,
                 <&pmc WM8505_CLK_VPP>,
                 <&pmc WM8505_CLK_GE>;
        clock-names = "dvo", "govrh", "vpp", "ge";
        wm,ge = <&graphics>;

        port {
            display_out: endpoint {
                remote-endpoint = <&panel_in>;
            };
        };
    };
```

## Documentation/devicetree/bindings/power/supply/wm,wm8505-battery.yaml
```yaml
# SPDX-License-Identifier: (GPL-2.0-only OR BSD-2-Clause)
%YAML 1.2
---
$id: http://devicetree.org/schemas/power/supply/wm,wm8505-battery.yaml#
$schema: http://devicetree.org/meta-schemas/core.yaml#

title: WonderMedia WM8505 Battery Monitor

maintainers:
  - Logan Russell <me@lrussell.net>

description:
  The WM8505 netbook has no ADC and measures its battery voltage by timing
  how long an RC network charged from the battery rail takes to pull a GPIO
  past its input threshold.

allOf:
  - $ref: power-supply.yaml#

properties:
  compatible:
    const: wm,wm8505-battery

  sense-gpios:
    maxItems: 1
    description: GPIO wired to the RC measurement network

  charge-done-gpios:
    maxItems: 1
    description: GPIO asserted by the charger when charging is complete

  low-battery-gpios:
    maxItems: 1
    description: GPIO asserted by the low-voltage comparator

  alarm-enable-gpios:
    maxItems: 1
    description:
      GPIO held as an input to keep the low-battery comparator's read path
      alive; not otherwise used.

  wm,time-constant-us:
    minimum: 1
    description: RC time constant of the measurement network

  wm,threshold-microvolt:
    minimum: 1
    description: Input threshold voltage of the sense GPIO

  monitored-battery: true

required:
  - compatible
  - sense-gpios
  - charge-done-gpios
  - wm,time-constant-us
  - wm,threshold-microvolt
  - monitored-battery

unevaluatedProperties: false

examples:
  - |
    #include <dt-bindings/gpio/gpio.h>

    battery-monitor {
        compatible = "wm,wm8505-battery";
        sense-gpios = <&pinctrl 4 GPIO_ACTIVE_HIGH>;
        charge-done-gpios = <&pinctrl 1 GPIO_ACTIVE_HIGH>;
        low-battery-gpios = <&pinctrl 227 GPIO_ACTIVE_LOW>;
        alarm-enable-gpios = <&pinctrl 259 GPIO_ACTIVE_HIGH>;
        monitored-battery = <&battery>;
        power-supplies = <&charger>;
        wm,time-constant-us = <294000>;
        wm,threshold-microvolt = <2344000>;
    };
```

## Documentation/devicetree/bindings/sound/wm,wm8505-ac97.yaml
```yaml
# SPDX-License-Identifier: (GPL-2.0-only OR BSD-2-Clause)
%YAML 1.2
---
$id: http://devicetree.org/schemas/sound/wm,wm8505-ac97.yaml#
$schema: http://devicetree.org/meta-schemas/core.yaml#

title: WonderMedia WM8505 AC97 Audio Controller

maintainers:
  - Logan Russell <me@lrussell.net>

properties:
  compatible:
    const: wm,wm8505-ac97

  reg:
    maxItems: 1

  interrupts:
    maxItems: 1

  clocks:
    maxItems: 2

  clock-names:
    items:
      - const: ac97
      - const: i2s

  dmas:
    items:
      - description: TX (playback) DMA channel
      - description: RX (capture) DMA channel

  dma-names:
    items:
      - const: tx
      - const: rx

  speaker-gpios:
    maxItems: 1
    description: GPIO for controlling the headphone/speaker amplifier

required:
  - compatible
  - reg
  - interrupts
  - clocks
  - clock-names
  - dmas
  - dma-names

additionalProperties: false

examples:
  - |
    #include <dt-bindings/clock/wm8505-clock.h>
    #include <dt-bindings/gpio/gpio.h>

    ac97@d8290000 {
        compatible = "wm,wm8505-ac97";
        reg = <0xd8290000 0x10000>;
        interrupts = <42>;
        clocks = <&pmc WM8505_CLK_AC97>, <&pmc WM8505_CLK_I2S>;
        clock-names = "ac97", "i2s";
        dmas = <&dmac 18>, <&dmac 19>;
        dma-names = "tx", "rx";
        speaker-gpios = <&pinctrl 3 GPIO_ACTIVE_LOW>;
    };
```
